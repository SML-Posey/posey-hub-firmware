## CMakeLists.txt
```
cmake_minimum_required(VERSION 3.20.0)

set(CMAKE_CXX_STANDARD 17)
set(CMAKE_CXX_STANDARD_REQUIRED ON)

set(CONFIG_LIB_CPLUSPLUS ON)
set(CONFIG_NEWLIB_LIBC ON)

find_package(Zephyr REQUIRED HINTS $ENV{ZEPHYR_BASE})
project(posey-hub-firmware)

file(GLOB_RECURSE SRCS_CPP ${CMAKE_SOURCE_DIR}/src/*.cpp)
file(GLOB_RECURSE SRCS_C ${CMAKE_SOURCE_DIR}/src/*.c)
target_sources(app PRIVATE ${SRCS_CPP} ${SRCS_C})
target_include_directories(app PRIVATE
    ${CMAKE_SOURCE_DIR}/src
    ${CMAKE_SOURCE_DIR}/src/posey-lib)

zephyr_library_include_directories(.)
```

## prj.conf
```kconfig
# CONFIG_ROLE_HUB=y

# CONFIG_SPEED_OPTIMIZATIONS=y

# Debug enable/disable
CONFIG_DEBUG=y
CONFIG_DEBUG_INFO=y
CONFIG_DEBUG_THREAD_INFO=y
CONFIG_THREAD_NAME=y
CONFIG_THREAD_ANALYZER=y
CONFIG_EXCEPTION_STACK_TRACE=y
# CONFIG_DEBUG_COREDUMP=y
# CONFIG_DEBUG_COREDUMP_MEMORY_DUMP_MIN=y
# CONFIG_DEBUG_COREDUMP_BACKEND_LOGGING=y
CONFIG_RESET_ON_FATAL_ERROR=y

CONFIG_REBOOT=y

# Configure USB CDC ACM.
CONFIG_USB_DEVICE_STACK=y
CONFIG_USB_DEVICE_VID=0x4242
CONFIG_USB_DEVICE_PID=0x0001
CONFIG_USB_DEVICE_MANUFACTURER="SML-Posey"
CONFIG_USB_DEVICE_PRODUCT="SML-Posey Hub"
CONFIG_USB_DEVICE_SN="42420001"

CONFIG_NRFX_UARTE0=y
CONFIG_UART_INTERRUPT_DRIVEN=y
CONFIG_UART_LINE_CTRL=y
CONFIG_USB_DEVICE_INITIALIZE_AT_BOOT=n

# Enable C++
CONFIG_NEWLIB_LIBC=y
CONFIG_NEWLIB_LIBC_FLOAT_PRINTF=y
CONFIG_CPP=y
CONFIG_STD_CPP17=y
CONFIG_REQUIRES_FULL_LIBCPP=y

# Enable floating point stuff.
CONFIG_FPU=y
CONFIG_CBPRINTF_FP_SUPPORT=y

# Enable PWM for LEDs.
CONFIG_PWM=y

# Bigger buffers. We're not doing anything else with all
# that juicy RAM.
CONFIG_HEAP_MEM_POOL_SIZE=4096
# # CONFIG_PRIVILEGED_STACK_SIZE=2048
CONFIG_SYSTEM_WORKQUEUE_STACK_SIZE=4096
CONFIG_MAIN_STACK_SIZE=4096
# CONFIG_IDLE_STACK_SIZE=2048
# CONFIG_ISR_STACK_SIZE=2048
CONFIG_LOG_BUFFER_SIZE=4096

# Bluetooth configuration
CONFIG_BT_DEVICE_NAME="Posey Hub"
CONFIG_BT=y
CONFIG_BT_SMP=y
CONFIG_BT_DEBUG_LOG=n

CONFIG_BT_CENTRAL=y
CONFIG_BT_OBSERVER=y
CONFIG_BT_PERIPHERAL=y

CONFIG_BT_DEVICE_APPEARANCE=1345
CONFIG_BT_MAX_CONN=5
CONFIG_BT_MAX_PAIRED=4

CONFIG_BT_L2CAP_TX_BUF_COUNT=10
CONFIG_BT_L2CAP_TX_MTU=498
CONFIG_BT_BUF_ACL_TX_COUNT=10
CONFIG_BT_BUF_ACL_TX_SIZE=251
CONFIG_BT_L2CAP_DYNAMIC_CHANNEL=y

CONFIG_BT_USER_PHY_UPDATE=y
CONFIG_BT_USER_DATA_LEN_UPDATE=y

CONFIG_BT_BUF_ACL_RX_SIZE=502
CONFIG_BT_ATT_PREPARE_COUNT=10

CONFIG_BT_RX_STACK_SIZE=10240

CONFIG_BT_GATT_CLIENT=y

# Enable the NUS service
CONFIG_BT_NUS=y
CONFIG_BT_NUS_CLIENT=y

CONFIG_BT_SCAN_WITH_IDENTITY=y

# BLE Scanning
CONFIG_BT_SCAN=y
CONFIG_BT_SCAN_FILTER_ENABLE=y
CONFIG_BT_SCAN_NAME_CNT=4
CONFIG_BT_GATT_DM=y

# Enable bonding
CONFIG_BT_SETTINGS=y
CONFIG_FLASH=y
CONFIG_FLASH_PAGE_LAYOUT=y
CONFIG_FLASH_MAP=y
CONFIG_NVS=y
CONFIG_SETTINGS=y

CONFIG_BT_EXT_ADV=y
# CONFIG_BT_CTLR_ADV_EXT=y
# CONFIG_BT_CTLR_PHY_CODED=y
# CONFIG_BT_CTLR_SDC_SCAN_BUFFER_COUNT=10
# CONFIG_BT_CTLR_PHY_2M=y
# CONFIG_BT_CTLR_DATA_LENGTH_MAX=251
# CONFIG_BT_CTLR_CONN_RSSI=y

# Config logger on RTT.
CONFIG_CONSOLE=y
CONFIG_UART_CONSOLE=n
CONFIG_RTT_CONSOLE=y
CONFIG_STDOUT_CONSOLE=y

CONFIG_PRINTK=y

CONFIG_LOG=y
CONFIG_LOG_MODE_MINIMAL=n
CONFIG_LOG_MODE_DEFERRED=y
CONFIG_USE_SEGGER_RTT=y
CONFIG_LOG_BACKEND_RTT=y
CONFIG_LOG_BACKEND_UART=n

CONFIG_USB_DRIVER_LOG_LEVEL_ERR=y
CONFIG_USB_DEVICE_LOG_LEVEL_ERR=y
CONFIG_SERIAL=y
```

## nrf5340dk_nrf5340_cpuapp.overlay
```dts
/ {
    aliases {
        // pwm-led0 = &pwm_led0;
        pwm-led1 = &pwm_led0;
        pwm-led2 = &pwm_led0;
    };
};
```

## src/main.c
```c
#include <stdbool.h>
#include <stdint.h>
#include <zephyr/kernel.h>
#include <zephyr/logging/log.h>

#include "cdc_acm.h"

LOG_MODULE_REGISTER(posey_hub, LOG_LEVEL_INF);

#define DummyDataSize (1024)

inline uint32_t get_time_us() {
    return k_cyc_to_us_floor32(sys_clock_tick_get());
}

int main(void) {
    LOG_INF("Getting CDC ACM device...");
    const struct device* dev = cdc_acm_get_device();
    if (dev == NULL) {
        LOG_ERR("Could not get CDC ACM device!");
        return -1;
    }

    LOG_INF("Initializing CDC ACM...");
    if (cdc_acm_init(dev) < 0) {
        LOG_ERR("Could not initialize CDC ACM!");
        return -1;
    }

    // Initialize dummy data to be sent.
    LOG_INF("Initializing dummy data...");
    static uint8_t dummy_data[DummyDataSize];
    for (uint16_t i = 0; i < DummyDataSize; i++) {
        dummy_data[i] = '0' + (i % 10);
    }
    for (uint16_t i = DummyDataSize - 4; i < DummyDataSize; i++) {
        dummy_data[i] = '-';
    }

    // We want to send the dummy data at a rate of 100 KB/s.
    LOG_INF("Sending dummy data at 100 KB/s...");
    const uint32_t PacketDelay_us = 1e6 / (100 * 1024 / DummyDataSize);
    uint16_t iter = 0;
    while (true) {
        // Get start time in us.
        uint32_t t0 = get_time_us();

        // Conver iter to a string, and roll over at 10000.
        static char iter_str[5];
        snprintf(iter_str, 5, "%04d", iter);
        strncpy((char*)&dummy_data[DummyDataSize - 4], iter_str, 4);
        iter = (iter + 1) % 10000;

        cdc_acm_send(dev, dummy_data, DummyDataSize);

        // Delay.
        uint32_t t1 = get_time_us();
        uint32_t cycle_dt = t1 - t0;
        if (cycle_dt >= PacketDelay_us)
            continue;
        k_usleep(PacketDelay_us - cycle_dt);
    }

    LOG_ERR("Exited main loop!");
    return 0;
}
```

## src/main.cpp
```c
#include "TaskHub.hpp"
#include "platform.hpp"

#include <zephyr/sys/reboot.h>
// #include "memfault/core/trace_event.h"

#define LOG_MODULE_NAME posey_hub
LOG_MODULE_REGISTER(LOG_MODULE_NAME);

void die(const char* const message) {
    // MEMFAULT_TRACE_EVENT_WITH_LOG(
    //     system_death,
    //     "Message: %s", message);
    LOG_ERR("%s", message);
    LOG_ERR("Waiting 5s then rebooting.");
    Clock::delay_msec(5000);
    sys_reboot(SYS_REBOOT_COLD);
}

int main() {
    TaskHub task(reader, writer);
    RateTask rtmain(task, 50);

    if (!init_platform())
        die("Platform init failed.");

    if (rtmain.setup()) {
        LOG_INF("Setup complete. Entering loop.\n");
        while (true) {
            rtmain.loop();
        }
    } else
        die("rtmain.setup() failed.");
    return 0;
}
```

## src/TaskHub.cpp
```c
#include "platform.hpp"
#include "platform/config.h"

#include "TaskHub.hpp"

#include "MessageAck.hpp"

#include <zephyr/logging/log.h>
#include <zephyr/logging/log_ctrl.h>
#include <zephyr/sys/reboot.h>

#include <zephyr/drivers/pwm.h>

#include "posey-platform/platform/io/NordicNUSDriver.h"

#define LOG_MODULE_NAME posey_task_hub
LOG_MODULE_REGISTER(LOG_MODULE_NAME);

// LEDs.
static const struct pwm_dt_spec red_pwm_led =
    PWM_DT_SPEC_GET(DT_ALIAS(pwm_led0));
static const struct pwm_dt_spec green_pwm_led =
    PWM_DT_SPEC_GET(DT_ALIAS(pwm_led1));
static const struct pwm_dt_spec blue_pwm_led =
    PWM_DT_SPEC_GET(DT_ALIAS(pwm_led2));

bool TaskHub::setup() {
    LOG_INF("Setting up TaskHub...");

    LOG_INF("Adding message listener...");
    if (!ml.add_listener(cmd)) {
        LOG_ERR("Could not add message listener!");
        return false;
    }

    LOG_INF("Checking LEDs are ready...");
    if (!pwm_is_ready_dt(&red_pwm_led) || !pwm_is_ready_dt(&green_pwm_led) ||
        !pwm_is_ready_dt(&blue_pwm_led)) {
        LOG_ERR("Error: one or more LED PWM devices not ready\n");
        return 0;
    }
    set_rgb(0, 1, 0);

    LOG_INF("TaskHub setup complete.");

    return true;
}

void TaskHub::set_rgb(const float r, const float g, const float b) {
    int ret;

    uint32_t pulse_red = (uint32_t)(r * red_pwm_led.period);
    ret = pwm_set_pulse_dt(&red_pwm_led, pulse_red);
    if (ret != 0) {
        LOG_ERR("Error %d: red write failed\n", ret);
    }

    uint32_t pulse_green = (uint32_t)(g * green_pwm_led.period);
    ret = pwm_set_pulse_dt(&green_pwm_led, pulse_green);
    if (ret != 0) {
        LOG_ERR("Error %d: green write failed\n", ret);
    }

    uint32_t pulse_blue = (uint32_t)(b * blue_pwm_led.period);
    ret = pwm_set_pulse_dt(&blue_pwm_led, pulse_blue);
    if (ret != 0) {
        LOG_ERR("Error %d: blue write failed\n", ret);
    }
}

void TaskHub::loop() {
    static const uint32_t max_loop_time = 1e3 / 50;
    static uint32_t iter = 0;

    tm.message.t_start_ms = Clock::get_msec<uint32_t>();

    // Check for messages. Process everything available, we'll
    // let this task overrun.
    ml.poll(reader);
    while (true) {
        auto mid = ml.process_next();
        if (mid <= -1)
            break;
        process_message(mid);
    }

    // Send task TM at 1Hz.
    if (iter % 50 == 0) {
        tm.message.ble_throughput = num_connected_sensors();
        tm.serialize();
        process_data(NULL, 0xFA, tm.buffer.get_buffer(), tm.buffer.used());
    }

    // Indicate BT connection count every 10 seconds.
    static bool indicating_connections = false;
    static uint32_t next_indicate = 0;
    static bool next_indicate_on = false;
    static int num_connections = 0;
    if (iter % 500 == 0) {
        num_connections = num_connected_sensors();
        LOG_INF("Connected sensors: %d", num_connections);
        indicating_connections = true;
        next_indicate = iter;
        next_indicate_on = true;
    }
    if (indicating_connections && (iter == next_indicate)) {
        if (next_indicate_on) {
            if (num_connections == 0) {
                set_rgb(1, 0, 0);
                next_indicate = iter + 50;
            } else {
                set_rgb(0, 0, 1);
                next_indicate = iter + 20;
            }
            next_indicate_on = false;
        } else {
            set_rgb(0, 0, 0);
            next_indicate_on = true;
            next_indicate = iter + 30;
            --num_connections;
        }

        if (next_indicate_on && (num_connections < 0)) {
            indicating_connections = false;
            set_rgb(0, 1, 0);
        }
    }

    ++iter;

    // Update missed deadlines if needed.
    tm.message.t_end_ms = Clock::get_msec<uint32_t>();
    if (tm.message.t_end_ms - tm.message.t_start_ms > max_loop_time) {
        tm.message.missed_deadline++;
    }
}

void TaskHub::process_message(const uint16_t mid) {
    bool invalid_checksum = false;

    // Command message?
    if (mid == Command::message_id) {
        // Extract command.
        if (cmd.valid_checksum()) {
            auto& msg = cmd.deserialize();
            cmd.message.ack = MessageAck::OK;
            cmd.serialize();
            process_data(
                NULL, 0xFA, cmd.buffer.get_buffer(), cmd.buffer.used());
            Clock::delay_msec(500);

            LOG_INF("Received %s command", msg.command_str());

            // Handle command.
            switch (msg.command) {
                case Command::NoOp:
                    LOG_WRN("No operation!");
                    break;

                case Command::Reboot:
                    LOG_INF("Waiting 5s then rebooting.");
                    Clock::delay_msec(5000);
                    sys_reboot(SYS_REBOOT_COLD);
                    break;

                case Command::Configure:
                case Command::ConnectPeripheral:
                    LOG_WRN("Not implemented.");
                    break;
                default:
                    LOG_WRN("Unknown command");
                    break;
            }
        } else {
            invalid_checksum = true;
            cmd.message.ack = MessageAck::Resend;
            cmd.serialize();
            process_data(
                NULL, 0xFA, cmd.buffer.get_buffer(), cmd.buffer.used());
        }
    }

    // Invalid checksum?
    if (invalid_checksum) {
        tm.message.invalid_checksum++;
    }
}
```

## src/TaskHub.hpp
```c
#pragma once

#include "MessageID.hpp"

#include "platform/BaseTask.hpp"

#include "platform/io/BaseMessageReader.hpp"
#include "platform/io/BaseMessageWriter.hpp"
#include "platform/io/BufferMessagePair.hpp"
#include "platform/io/MessageListener.hpp"

#include "platform/hardware/PeripheralConnection.hpp"

#include "control/Command.hpp"
#include "control/DataSummary.hpp"

#include "TaskHubTelemetry.hpp"

class TaskHub : public BaseTask {
    public:
        TaskHub(BaseMessageReader& reader, BaseMessageWriter& writer)
            : reader(reader), writer(writer) {}

        bool setup() override;
        void loop() override;

    protected:
        void process_message(const uint16_t mid);
        void set_rgb(const float r, const float g, const float b);

    protected:
        // PeripheralConnection peripherals[4];

        BaseMessageReader& reader;
        BaseMessageWriter& writer;
        MessageListener<1, 200> ml;

        // Messages handled.
        BufferMessagePair<TaskHubTelemetry> tm;
        BufferMessagePair<DataSummary> tm_data_summary;
        BufferMessagePair<Command> cmd;  // <->
};
```

## src/TaskHubTelemetry.hpp
```c
#pragma once

#include "MessageID.hpp"

#include "platform/hardware/PeripheralConnection.hpp"
#include "platform/io/BufferSerializer.hpp"

class TaskHubTelemetry {
    public:
        static constexpr uint8_t message_id = MessageID::TaskWaist;
        static constexpr uint16_t MessageSize = 1        // Message ID
                                                + 4 * 2  // Times
                                                + 1 * 1  // Invalid checksum
                                                + 1 * 1  // Missed deadline
                                                + 4      // BLE throughput
            ;
        typedef BufferSerializer<MessageSize> Buffer;

    public:
        void serialize(Buffer& buffer) const {
            static auto message_id = this->message_id;
            buffer.reset();
            buffer.write_syncword()
                .write(message_id)
                .write(t_start_ms)
                .write(t_end_ms)
                .write(invalid_checksum)
                .write(missed_deadline)
                .write(ble_throughput)
                .write_checksum();
        }

        bool deserialize(Buffer& buffer) {
            buffer.rewind();
            buffer.read<uint16_t>();  // Syncword.
            buffer.read<uint8_t>();   // Message ID.
            buffer.read(t_start_ms)
                .read(t_end_ms)
                .read(invalid_checksum)
                .read(missed_deadline)
                .read(ble_throughput);
            // Checksum.
            return true;
        }

    public:
        uint32_t t_start_ms = 0;
        uint32_t t_end_ms = 0;

        uint8_t invalid_checksum = 0;
        uint8_t missed_deadline = 0;

        uint32_t ble_throughput = 0;
};
```

## src/cdc_acm.c
```c
#include "cdc_acm.h"

#include <stdio.h>
#include <string.h>
#include <zephyr/drivers/uart.h>
#include <zephyr/kernel.h>
#include <zephyr/sys/ring_buffer.h>

#include <zephyr/logging/log.h>
#include <zephyr/usb/usb_device.h>
#include <zephyr/usb/usbd.h>

LOG_MODULE_REGISTER(cdc_acm, LOG_LEVEL_INF);

#define RingBufferSize 1024
static uint8_t outgoing_data[RingBufferSize];
struct ring_buf outgoing_ringbuf;

static void interrupt_handler(const struct device* dev, void* user_data) {
    ARG_UNUSED(user_data);

    while (uart_irq_update(dev) && uart_irq_is_pending(dev)) {
        if (uart_irq_rx_ready(dev)) {
            static uint8_t buffer[1024];
            int recv_len = uart_fifo_read(dev, buffer, 1024);
            LOG_INF("Received %d bytes.", recv_len);
        }

        if (uart_irq_tx_ready(dev)) {
            static uint8_t buffer[RingBufferSize];
            int rb_len =
                ring_buf_get(&outgoing_ringbuf, buffer, sizeof(buffer));
            if (!rb_len) {
                uart_irq_tx_disable(dev);
                continue;
            }

            int send_len = uart_fifo_fill(dev, buffer, rb_len);
            if (send_len < rb_len) {
                LOG_ERR("Drop %d bytes", rb_len - send_len);
            }
        }
    }
}

const struct device* cdc_acm_get_device() {
    const struct device* dev = DEVICE_DT_GET_ONE(zephyr_cdc_acm_uart);
    if (!device_is_ready(dev)) {
        LOG_ERR("CDC ACM device not ready");
        return NULL;
    }
    return dev;
}

int cdc_acm_init(const struct device* dev) {
    int ret;

    ret = usb_enable(NULL);
    if (ret != 0) {
        LOG_ERR("Failed to enable USB");
        return ret;
    }

    ring_buf_init(&outgoing_ringbuf, sizeof(outgoing_data), outgoing_data);

    k_msleep(500);

    uart_irq_callback_set(dev, interrupt_handler);
    uart_irq_rx_enable(dev);

    return 0;
}

uint16_t cdc_acm_send(
    const struct device* dev, const uint8_t* data, uint16_t len) {
    uint16_t to_write = ring_buf_put(&outgoing_ringbuf, data, len);
    if (to_write) {
        uart_irq_tx_enable(dev);
    }
    return to_write;
}
```

## src/cdc_acm.h
```c
#pragma once

#ifdef __cplusplus
extern "C" {
#endif

#include <stdint.h>
#include <zephyr/device.h>

const struct device* cdc_acm_get_device();
int cdc_acm_init(const struct device* dev);
uint16_t cdc_acm_send(
    const struct device* dev, const uint8_t* data, uint16_t len);

#ifdef __cplusplus
}
#endif
```
